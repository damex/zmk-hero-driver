## Kconfig
```kconfig
# Copyright 2026 Roman Kuzmitskii (@damex)
# SPDX-License-Identifier: MIT

menuconfig INPUT_HERO
    bool "Logitech HERO mouse optical sensor"
    select SPI
    select COUNTER
    depends on INPUT
    depends on DT_HAS_LOGITECH_HERO_ENABLED
    help
      Reverse-engineered driver for the Logitech HERO sensor (G305, G603).

if INPUT_HERO

config INPUT_HERO_INIT_PRIORITY
    int "HERO initialization priority"
    default INPUT_INIT_PRIORITY

config INPUT_HERO_THREAD_STACK_SIZE
    int "HERO poll thread stack size"
    default 2048

config INPUT_HERO_THREAD_PRIORITY
    int "HERO poll thread priority"
    default 5

module = INPUT_HERO
module-str = INPUT_HERO
source "${ZEPHYR_BASE}/subsys/logging/Kconfig.template.log_config"

endif # INPUT_HERO
```

## dts/bindings/input/logitech,hero.yaml
```yaml
# Copyright 2026 Roman Kuzmitskii (@damex)
# SPDX-License-Identifier: MIT

description: |
  Logitech HERO mouse optical sensor (reverse-engineered).
  SPI mode 3, 4 MHz. HERO has no dedicated motion-ready line (MISO doubles as
  the motion/wake pin), so this driver polls at the configured rate.

compatible: "logitech,hero"

include: spi-device.yaml

properties:
  cpi:
    type: int
    default: 1000
    description: "Resolution in CPI. Range 50-12000, step 50."
  poll-rate-hz:
    type: int
    default: 1000
    description: |
      Motion poll rate in Hz. Clamped to 10000 (100 us SPI floor); intermediate
      values that don't divide cleanly into microseconds are rounded down.
  min-frame-rate-hz:
    type: int
    default: 1000
    description: "Frame-rate floor when idle. Range ~32-8333 Hz, 20 us step."
  run-to-rest-sec:
    type: int
    default: 6
    description: "Seconds of inactivity before the sensor enters low-power rest mode."
  swap-xy:
    type: boolean
    description: "Swap X and Y axes at report time."
  invert-x:
    type: boolean
    description: "Negate X axis at report time."
  invert-y:
    type: boolean
    description: "Negate Y axis at report time."
  event-type:
    type: int
    required: true
    description: "input event type to report, e.g. INPUT_EV_REL."
  x-input-code:
    type: int
    required: true
    description: "input code for the X axis, e.g. INPUT_REL_X."
  y-input-code:
    type: int
    required: true
    description: "input code for the Y axis, e.g. INPUT_REL_Y."
```

## tests/unit/testcase.yaml
```yaml
# Copyright 2026 Roman Kuzmitskii (@damex)
# SPDX-License-Identifier: MIT

common:
  tags:
    - hero

tests:
  hero.unit:
    type: unit
```
